## Documentation/devicetree/bindings/display/bridge/toshiba,tc358762.txt
```
Toshiba TC358762 Display Interface Bridge

Required properties:
 - compatible: "toshiba,tc358762"
 - reg: i2c address of the bridge
 - clock-names: names of clocks
 - clocks: phandles to input clocks

Optional properties:
 - reset-gpios: OF device-tree gpio specification for RSTX pin
                (active low system reset)
 - toshiba,i2c-pull-up: to specify pull up is required

Example:

		toshiba@b{
                        compatible = "toshiba,tc358762";
                        vdds_l6-supply = <&pm8909_l6>;
                        vdda_l2-supply = <&pm8909_l2>;
                        vdd_l17-supply = <&pm8909_l17>;
                        reg = <0xb>;
                        qcom,clk-src = "BBCLK2";
                        clocks = <&clock_rpm clk_bb_clk2>;
                        clock-names = "bb_clk2";
                        toshiba,reset-gpio = <&msm_gpio 25 0x00>;
                        toshiba,i2c-pull-up;
                        status = "okay";
                };
```

## Documentation/devicetree/bindings/gpio/gpio-xp3.txt
```
XP3_GPIO Support for 8909 chip

Required properties:
- compatible:	"xp3-gpios" for MSM controllers

Optional property:
- pinctrl-names:The list of names to assign states. List entry 0 defines the
		name for integer state ID 0, list entry 1 for state ID 1, and
		so on.
- gpios:	Contains 3 fields of the form <&gpio_controller pin_num flags>
- pinctrl-n:	List of phandles, each pointing at a pin configuration
		node within a pin controller.


Example:

        xp3-gpios {
		compatible = "xp3-gpios";
		pinctrl-names = "active","suspend";
		hw-id1_gpio = <&msm_gpio 23 0x00>;
		hw-id2_gpio = <&msm_gpio 27 0x00>;
		pinctrl-0 = <&hw_ver_active>;
		pinctrl-1 = <&hw_ver_suspend>;
        };
```

## Documentation/devicetree/bindings/iio/pressure/spl06.txt
```
SPL06 Digital Pressure Sensor

Required properties:
- compatible: "qcom,spl06"
- reg: the I2C address or SPI chip select the device will respond to

Optional properties:
- vdd-supply: an optional regulator that needs to be on to provide VDD
  power to the sensor.

Example:

	spl06@76 {
		compatible = "qcom,spl06";
		reg = <0x76>;
		vdd-supply = <&pm8909_l6>;
        };
```

## Documentation/devicetree/bindings/panel/rocktech,uc1617s.txt
```
Rocktech UltraChip 128 x 128 passive LCD controller

Required properties:
  - compatible: "rocktech,uc1617sfb-spi"
  - reg: address of the panel on SPI bus
  - vdd-supply: core voltage supply
  - rocktech,reset-gpios: GPIO for the reset pin

The panel must obey rules for SPI slave device specified in document [1].

[1] Documentation/devicetree/bindings/spi/spi-bus.txt

Example:
	&spi_0 {
		status = "okay";
		spi-max-frequency = <11000000>;
		pinctrl-names = "spi_default", "spi_sleep";
		pinctrl-0 = <&spi0_default  &spi0_cs0_active>;
		pinctrl-1 = <&spi0_sleep &spi0_cs0_sleep>;
		spi-slave@0 {
		        compatible = "rocktech,uc1617sfb-spi";
		        reg = <0>;
		        status = "okay";
		        spi-max-frequency = <11000000>;
		        vdd-supply = <&pm8909_l5>;
		        avdd-supply = <&pm8909_l17>;
		        pinctrl-names = "spi_default", "spi_sleep";
		        pinctrl-0 = <&spi0_default  &spi0_cs0_active>;
		        pinctrl-1 = <&spi0_sleep &spi0_cs0_sleep>;
		        rocktech,reset-gpios = <&msm_gpio 28 0x01>;
		        rocktech,datacmd-gpios = <&msm_gpio 9 0x01>;
		        rocktech,bklt-ctrl = "third-party";
		        rocktech,default-bklt = <15>;
		        rocktech,width = <96>;
		        rocktech,height = <96>;
		};
	};
```

## drivers/input/misc/smtc/Kconfig
```kconfig
# Semtech Capacitive Touch Button driver configuration
menu "Semtech Cap Touch"

config INPUT_SX9310
	tristate "SX9310 based capacitive touch button"
	depends on I2C
	help
	  Say Y here if you have a SX9310.

	  If unsure, say N.

	  To compile this driver as a module, choose M here: the
	  module will be called sx8651.

endmenu
```

## drivers/input/touchscreen/FT5436/Kconfig
```kconfig
config TOUCHSCREEN_FTS
        tristate "FocalTech touchscreens"
        depends on I2C
        help
          Say Y here if you have a focaltech touchscreen.

          If unsure, say N.

          To compile this driver as a module, choose M here: the
          module will be called fts_ts.
```

## drivers/input/touchscreen/tpd_property/Kconfig
```kconfig
config TOUCHSCREEN_PROPERTY
	tristate "Touchscreen common interface"
	depends on I2C
	help
	  Say Y here if you have to need touchpanel common interface

	  If unsure, say N.
```

## drivers/media/platform/msm/Kconfig
```kconfig
source "drivers/media/platform/msm/vidc/Kconfig"

#
# MSM camera configuration
#

comment "Qualcomm MSM Camera And Video"

menuconfig MSM_CAMERA
	bool "Qualcomm MSM camera and video capture support"
	depends on ARCH_MSM && VIDEO_V4L2 && I2C
	---help---
	  Say Y here to enable selecting the video adapters for
	  Qualcomm msm camera and video capture drivers. enabling this
	  adds support for the camera driver stack including sensor, isp
	  and postprocessing drivers for legacy chipsets.

config MSM_CAMERA_DEBUG
	bool "Qualcomm MSM camera debugging with printk"
	depends on MSM_CAMERA
	default n
	---help---
	  Enable printk() debug for msm camera

config MSM_CAMERA_AUTOMOTIVE
	bool "Qualcomm MSM camera for automotive support"
	depends on MSM_CAMERA
	default n
	---help---
	  Enables support for automotive targets

menuconfig MSMB_CAMERA
	bool "Qualcomm MSM camera and video capture 2.0 support"
	depends on ARCH_MSM && VIDEO_V4L2 && I2C
	---help---
	  Say Y here to enable selecting the video adapters for
	  Qualcomm msm camera and video capture 2.0, enabling this
	  adds support for the camera driver stack including sensor, isp
	  and postprocessing drivers.

menuconfig LENOVO_DIR_CAMERA
        bool "Lenovo MSM camera directory support"
        depends on MSMB_CAMERA
        ---help---
          Say Y here to enable selecting the vendor lenovo camera driver
          directory to compile into the kernel.

menuconfig QUALCOMM_DIR_CAMERA
        bool "Qualcomm MSM camera directory support"
        depends on MSMB_CAMERA
        ---help---
          Say Y here to enable selecting the vendor lenovo camera driver
          directory to compile into the kernel.

config CAMERA_WT_FACTORY_SUPPORTED
        bool "Lenovo Wingtech factory supported about camera"
        depends on MSMB_CAMERA
        ---help---
          Enable to support the wingtech factory about camera

config MSMB_CAMERA_DEBUG
        bool "Qualcomm MSM camera 2.0 debugging with printk"
        depends on MSMB_CAMERA
        ---help---
          Enable printk() debug for msm camera 2.0

if LENOVO_DIR_CAMERA
source "drivers/media/platform/msm/camera-lenovo/camera-driver/Kconfig"
endif # LENOVO_DIR_CAMERA

if QUALCOMM_DIR_CAMERA
source "drivers/media/platform/msm/camera_v2/Kconfig"
endif # QUALCOMM_DIR_CAMERA

source "drivers/media/platform/msm/dvb/Kconfig"
source "drivers/media/platform/msm/broadcast/Kconfig"
source "drivers/media/platform/msm/sde/Kconfig"
```

## drivers/platform/lenovo/Kconfig
```kconfig
# Lenovo configuration options

config MACH_LENOVO
	bool "Lenovo device"
	depends on ARCH_MSM
	help
	  Support for Lenovo products

config MACH_LENOVO_MSM8937
	bool "Lenovo MSM8937"
	depends on ARCH_MSM8937
	select MACH_LENOVO
	help
	  Support for MSM8937 Lenovo variants

menu "Lenovo board selection"

config MACH_LENOVO_KARATE
	bool "Karate board"
	select MACH_LENOVO_MSM8937
	help
	  Support for Lenovo K6/Power (karate)

config MACH_LENOVO_KARATEP
        bool "Karatep board"
        select MACH_LENOVO_MSM8937
        help
          Support for Lenovo K6/Note/Plus (karatep)

endmenu
```
