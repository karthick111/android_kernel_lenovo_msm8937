
qcom,2444194_lenovo_bl267_3080mah_averaged_masterslave_jun6th2016 {
	/* #2444194_Lenovo_BL267_3080mAh_averaged_MasterSlave_Jun6th2016*/
	qcom,max-voltage-uv = <4400000>;
	qcom,nom-batt-capacity-mah = <3080>;
	qcom,batt-id-kohm = <180>;
	qcom,battery-beta = <3380>;
	qcom,battery-type = "2444194_lenovo_bl267_3080mah_averaged_masterslave_jun6th2016";
	qcom,chg-rslow-comp-c1 = <3006381>;
	qcom,chg-rslow-comp-c2 = <3688927>;
	qcom,chg-rs-to-rslow = <746121>;
	qcom,chg-rslow-comp-thr = <0x99>;
	qcom,checksum = <0xAEBD>;
	qcom,gui-version = "PMI8950GUI - 2.0.0.16";
	qcom,fg-profile-data = [
		 DF 83 BD 7C 
		 08 81 22 77 
		 58 83 1C 64 
		 E3 82 0C 8E 
		 75 82 91 93 
		 41 B5 E6 C0 
		 52 17 06 88 
		 EC 7D C9 81 
		 33 7C 54 83 
		 BA 69 59 79 
		 87 86 4A 82 
		 C4 99 14 BD 
		 16 CA 5A 0D 
		 0C 0C B5 5B 
		 14 70 A5 FD 
		 78 34 4C 3F 
		 CF 30 00 00 
		 92 44 92 29 
		 1D 36 00 00 
		 00 00 00 00 
		 00 00 00 00 
		 61 6A F0 68 
		 33 78 B3 8A 
		 55 75 FF 68 
		 2D 60 74 80 
		 1E 74 60 62 
		 55 7C 82 A0 
		 1B CE 62 67 
		 64 A0 71 0C 
		 28 00 FF 36 
		 F0 11 30 03 
		 00 00 00 0C 
	];
};
