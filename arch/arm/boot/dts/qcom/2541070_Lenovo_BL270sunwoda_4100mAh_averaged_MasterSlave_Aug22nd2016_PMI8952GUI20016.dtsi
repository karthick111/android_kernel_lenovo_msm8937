
qcom,2541070_lenovo_bl270sunwoda_4100mah_averaged_masterslave_aug22nd2016 {
	/* #2541070_Lenovo_BL270sunwoda_4100mAh_averaged_MasterSlave_Aug22nd2016*/
	qcom,max-voltage-uv = <4400000>;
	qcom,nom-batt-capacity-mah = <4100>;
	qcom,batt-id-kohm = <47>;
	qcom,battery-beta = <3435>;
	qcom,battery-type = "2541070_lenovo_bl270sunwoda_4100mah_averaged_masterslave_aug22nd2016";
	qcom,chg-rslow-comp-c1 = <3407678>;
	qcom,chg-rslow-comp-c2 = <4804014>;
	qcom,chg-rs-to-rslow = <1071032>;
	qcom,chg-rslow-comp-thr = <0xA5>;
	qcom,checksum = <0x9EBE>;
	qcom,gui-version = "PMI8950GUI - 2.0.0.16";
	qcom,fg-profile-data = [
		 CF 83 2E 7C 
		 96 80 51 76 
		 62 83 50 74 
		 E9 89 44 95 
		 1C 82 91 9A 
		 CA BD E7 CA 
		 52 0E 5C 83 
		 1E 49 5D 72 
		 C6 5E 49 83 
		 D1 71 6C 74 
		 04 6F 44 82 
		 D8 99 0A BD 
		 D2 C9 6B 0C 
		 86 10 EC 58 
		 14 70 EE FC 
		 04 45 92 44 
		 56 42 00 00 
		 EC 45 29 40 
		 CE 34 00 00 
		 00 00 00 00 
		 00 00 00 00 
		 FE 6B 2A 6A 
		 16 6A 34 81 
		 D7 74 1F 60 
		 68 6A D3 80 
		 B1 74 2E 61 
		 24 8E 70 C8 
		 0B 19 62 A0 
		 5E A0 71 0C 
		 28 00 FF 36 
		 F0 11 30 03 
		 00 00 00 0C 
	];
};
