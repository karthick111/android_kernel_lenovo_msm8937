/* Copyright (c) 2014, The Linux Foundation. All rights reserved.
 *
 * This program is free software; you can redistribute it and/or modify
 * it under the terms of the GNU General Public License version 2 and
 * only version 2 as published by the Free Software Foundation.
 *
 * This program is distributed in the hope that it will be useful,
 * but WITHOUT ANY WARRANTY; without even the implied warranty of
 * MERCHANTABILITY or FITNESS FOR A PARTICULAR PURPOSE.  See the
 * GNU General Public License for more details.
 */

/*---------------------------------------------------------------------------
 * This file is autogenerated file using gcdb parser. Please do not edit it.
 * Update input XML file to add a new entry or update variable in this file
 * VERSION = "1.0"
 *---------------------------------------------------------------------------*/
&mdss_mdp {
	dsi_ili7807d_yas_1080p_video: qcom,mdss_dsi_ili7807d_yas_1080p_video {
		qcom,mdss-dsi-panel-name = "ili7807d_1080p_video_YAS";
		qcom,mdss-dsi-panel-type = "dsi_video_mode";
		qcom,mdss-dsi-panel-destination = "display_1";
		qcom,mdss-dsi-panel-framerate = <60>;
		qcom,mdss-dsi-virtual-channel-id = <0>;
		qcom,mdss-dsi-stream = <0>;
		qcom,mdss-dsi-panel-width = <1080>;
		qcom,mdss-dsi-panel-height = <1920>;
		qcom,mdss-dsi-h-front-porch = <120>;
		qcom,mdss-dsi-h-back-porch = <80>;
		qcom,mdss-dsi-h-pulse-width = <8>;
		qcom,mdss-dsi-h-sync-skew = <0>;
		qcom,mdss-dsi-v-back-porch = <20>;
		qcom,mdss-dsi-v-front-porch = <40>;
		qcom,mdss-dsi-v-pulse-width = <6>;
		qcom,mdss-dsi-h-left-border = <0>;
		qcom,mdss-dsi-h-right-border = <0>;
		qcom,mdss-dsi-v-top-border = <0>;
		qcom,mdss-dsi-v-bottom-border = <0>;
		qcom,mdss-dsi-bpp = <24>;
		qcom,mdss-dsi-color-order = "rgb_swap_rgb";
		qcom,mdss-dsi-underflow-color = <0xff>;
		qcom,mdss-dsi-border-color = <0>;
		qcom,mdss-dsi-on-command = [ 29 01 00 00 00 00 04 FF 78 07 01
 29 00 00 00 00 00 02 42 11
 29 00 00 00 00 00 02 43 99
 29 00 00 00 00 00 02 44 A3
 29 00 00 00 00 00 02 45 19
 29 00 00 00 00 00 02 46 2D
 29 00 00 00 00 00 02 4A 02
 29 00 00 00 00 00 02 4B 02
 29 00 00 00 00 00 02 50 29
 29 00 00 00 00 00 02 51 29
 29 00 00 00 00 00 02 A2 01
 29 00 00 00 00 00 02 A3 1C
 29 00 00 00 00 00 02 B3 60
 29 01 00 00 00 00 02 B4 60
 29 01 00 00 00 00 04 FF 78 07 01
 29 00 00 00 00 00 02 22 06
 29 00 00 00 00 00 02 36 00
 29 00 00 00 00 00 02 64 08
 29 00 00 00 00 00 02 6C 45
 29 00 00 00 00 00 02 6D 00
 29 01 00 00 00 00 02 5A 33
 29 01 00 00 00 00 04 FF 78 07 06
 29 00 00 00 00 00 02 00 41
 29 00 00 00 00 00 02 01 01
 29 00 00 00 00 00 02 02 44
 29 00 00 00 00 00 02 03 44
 29 00 00 00 00 00 02 04 02
 29 00 00 00 00 00 02 05 01
 29 00 00 00 00 00 02 06 08
 29 00 00 00 00 00 02 07 81
 29 00 00 00 00 00 02 08 00
 29 00 00 00 00 00 02 09 00
 29 00 00 00 00 00 02 0A 10
 29 00 00 00 00 00 02 0B 30
 29 00 00 00 00 00 02 0C 08
 29 00 00 00 00 00 02 0D 08
 29 00 00 00 00 00 02 0E 00
 29 00 00 00 00 00 02 0F 00
 29 00 00 00 00 00 02 10 00
 29 00 00 00 00 00 02 11 00
 29 00 00 00 00 00 02 12 00
 29 00 00 00 00 00 02 13 00
 29 00 00 00 00 00 02 14 00
 29 00 00 00 00 00 02 15 00
 29 00 00 00 00 00 02 31 08
 29 00 00 00 00 00 02 32 01
 29 00 00 00 00 00 02 33 00
 29 00 00 00 00 00 02 34 11
 29 00 00 00 00 00 02 35 10
 29 00 00 00 00 00 02 36 26
 29 00 00 00 00 00 02 37 22
 29 00 00 00 00 00 02 38 22
 29 00 00 00 00 00 02 39 0C
 29 00 00 00 00 00 02 3A 02
 29 00 00 00 00 00 02 3B 02
 29 00 00 00 00 00 02 3C 02
 29 00 00 00 00 00 02 3D 02
 29 00 00 00 00 00 02 3E 28
 29 00 00 00 00 00 02 3F 29
 29 00 00 00 00 00 02 40 2A
 29 00 00 00 00 00 02 41 08
 29 00 00 00 00 00 02 42 01
 29 00 00 00 00 00 02 43 00
 29 00 00 00 00 00 02 44 11
 29 00 00 00 00 00 02 45 10
 29 00 00 00 00 00 02 46 26
 29 00 00 00 00 00 02 47 22
 29 00 00 00 00 00 02 48 02
 29 00 00 00 00 00 02 49 0C
 29 00 00 00 00 00 02 4A 02
 29 00 00 00 00 00 02 4B 02
 29 00 00 00 00 00 02 4C 02
 29 00 00 00 00 00 02 4D 02
 29 00 00 00 00 00 02 4E 28
 29 00 00 00 00 00 02 4F 29
 29 00 00 00 00 00 02 50 2A
 29 00 00 00 00 00 02 61 0C
 29 00 00 00 00 00 02 62 01
 29 00 00 00 00 00 02 63 00
 29 00 00 00 00 00 02 64 10
 29 00 00 00 00 00 02 65 11
 29 00 00 00 00 00 02 66 26
 29 00 00 00 00 00 02 67 22
 29 00 00 00 00 00 02 68 22
 29 00 00 00 00 00 02 69 08
 29 00 00 00 00 00 02 6A 02
 29 00 00 00 00 00 02 6B 02
 29 00 00 00 00 00 02 6C 02
 29 00 00 00 00 00 02 6D 02
 29 00 00 00 00 00 02 6E 28
 29 00 00 00 00 00 02 6F 29
 29 00 00 00 00 00 02 70 2A
 29 00 00 00 00 00 02 71 0C
 29 00 00 00 00 00 02 72 01
 29 00 00 00 00 00 02 73 00
 29 00 00 00 00 00 02 74 10
 29 00 00 00 00 00 02 75 11
 29 00 00 00 00 00 02 76 26
 29 00 00 00 00 00 02 77 22
 29 00 00 00 00 00 02 78 02
 29 00 00 00 00 00 02 79 08
 29 00 00 00 00 00 02 7A 02
 29 00 00 00 00 00 02 7B 02
 29 00 00 00 00 00 02 7C 02
 29 00 00 00 00 00 02 7D 02
 29 00 00 00 00 00 02 7E 28
 29 00 00 00 00 00 02 7F 29
 29 00 00 00 00 00 02 80 2A
 29 00 00 00 00 00 02 D0 01
 29 00 00 00 00 00 02 D1 01
 29 00 00 00 00 00 02 D2 10
 29 00 00 00 00 00 02 D3 00
 29 00 00 00 00 00 02 D4 00
 29 00 00 00 00 00 02 D5 00
 29 00 00 00 00 00 02 D6 00
 29 00 00 00 00 00 02 D7 00
 29 00 00 00 00 00 02 D8 00
 29 00 00 00 00 00 02 D9 00
 29 00 00 00 00 00 02 DA 00
 29 00 00 00 00 00 02 DB 47
 29 00 00 00 00 00 02 DC 06
 29 00 00 00 00 00 02 DD 55
 29 00 00 00 00 00 02 96 00
 29 00 00 00 00 00 02 97 12
 29 00 00 00 00 00 02 A0 10
 29 00 00 00 00 00 02 A1 00
 29 00 00 00 00 00 02 A2 08
 29 00 00 00 00 00 02 A3 1E
 29 00 00 00 00 00 02 A7 00
 29 00 00 00 00 00 02 E5 80
 29 00 00 00 00 00 02 B2 00
 29 01 00 00 00 00 02 B3 00
 29 01 00 00 00 00 04 FF 78 07 02
 29 00 00 00 00 00 02 00 00
 29 00 00 00 00 00 02 01 17  
 29 00 00 00 00 00 02 02 00  
 29 00 00 00 00 00 02 03 25  
 29 00 00 00 00 00 02 04 00  
 29 00 00 00 00 00 02 05 40  
 29 00 00 00 00 00 02 06 00  
 29 00 00 00 00 00 02 07 56  
 29 00 00 00 00 00 02 08 00  
 29 00 00 00 00 00 02 09 69  
 29 00 00 00 00 00 02 0A 00  
 29 00 00 00 00 00 02 0B 7B  
 29 00 00 00 00 00 02 0C 00  
 29 00 00 00 00 00 02 0D 8B  
 29 00 00 00 00 00 02 0E 00  
 29 00 00 00 00 00 02 0F 9A  
 29 00 00 00 00 00 02 10 00  
 29 00 00 00 00 00 02 11 A8  
 29 00 00 00 00 00 02 12 00  
 29 00 00 00 00 00 02 13 D7  
 29 00 00 00 00 00 02 14 00  
 29 00 00 00 00 00 02 15 FE  
 29 00 00 00 00 00 02 16 01  
 29 00 00 00 00 00 02 17 3E  
 29 00 00 00 00 00 02 18 01  
 29 00 00 00 00 00 02 19 70  
 29 00 00 00 00 00 02 1A 01  
 29 00 00 00 00 00 02 1B C0  
 29 00 00 00 00 00 02 1C 01  
 29 00 00 00 00 00 02 1D FF  
 29 00 00 00 00 00 02 1E 02  
 29 00 00 00 00 00 02 1F 01  
 29 00 00 00 00 00 02 20 02  
 29 00 00 00 00 00 02 21 39  
 29 00 00 00 00 00 02 22 02  
 29 00 00 00 00 00 02 23 75  
 29 00 00 00 00 00 02 24 02  
 29 00 00 00 00 00 02 25 9C  
 29 00 00 00 00 00 02 26 02  
 29 00 00 00 00 00 02 27 D2  
 29 00 00 00 00 00 02 28 02  
 29 00 00 00 00 00 02 29 F5  
 29 00 00 00 00 00 02 2A 03  
 29 00 00 00 00 00 02 2B 22  
 29 00 00 00 00 00 02 2C 03  
 29 00 00 00 00 00 02 2D 30  
 29 00 00 00 00 00 02 2E 03  
 29 00 00 00 00 00 02 2F 40  
 29 00 00 00 00 00 02 30 03  
 29 00 00 00 00 00 02 31 52  
 29 00 00 00 00 00 02 32 03  
 29 00 00 00 00 00 02 33 65  
 29 00 00 00 00 00 02 34 03  
 29 00 00 00 00 00 02 35 7D  
 29 00 00 00 00 00 02 36 03  
 29 00 00 00 00 00 02 37 A2  
 29 00 00 00 00 00 02 38 03  
 29 00 00 00 00 00 02 39 CF  
 29 00 00 00 00 00 02 3A 03  
 29 00 00 00 00 00 02 3B E6  
 29 00 00 00 00 00 02 3C 00  
 29 00 00 00 00 00 02 3D 17  
 29 00 00 00 00 00 02 3E 00  
 29 00 00 00 00 00 02 3F 25  
 29 00 00 00 00 00 02 40 00  
 29 00 00 00 00 00 02 41 40  
 29 00 00 00 00 00 02 42 00  
 29 00 00 00 00 00 02 43 56  
 29 00 00 00 00 00 02 44 00  
 29 00 00 00 00 00 02 45 69  
 29 00 00 00 00 00 02 46 00  
 29 00 00 00 00 00 02 47 7B  
 29 00 00 00 00 00 02 48 00  
 29 00 00 00 00 00 02 49 8B  
 29 00 00 00 00 00 02 4A 00  
 29 00 00 00 00 00 02 4B 9A  
 29 00 00 00 00 00 02 4C 00  
 29 00 00 00 00 00 02 4D A8  
 29 00 00 00 00 00 02 4E 00  
 29 00 00 00 00 00 02 4F D7  
 29 00 00 00 00 00 02 50 00  
 29 00 00 00 00 00 02 51 FE  
 29 00 00 00 00 00 02 52 01  
 29 00 00 00 00 00 02 53 3E  
 29 00 00 00 00 00 02 54 01  
 29 00 00 00 00 00 02 55 70  
 29 00 00 00 00 00 02 56 01  
 29 00 00 00 00 00 02 57 C0  
 29 00 00 00 00 00 02 58 01  
 29 00 00 00 00 00 02 59 FF  
 29 00 00 00 00 00 02 5A 02  
 29 00 00 00 00 00 02 5B 01  
 29 00 00 00 00 00 02 5C 02  
 29 00 00 00 00 00 02 5D 39  
 29 00 00 00 00 00 02 5E 02  
 29 00 00 00 00 00 02 5F 75  
 29 00 00 00 00 00 02 60 02  
 29 00 00 00 00 00 02 61 9C  
 29 00 00 00 00 00 02 62 02  
 29 00 00 00 00 00 02 63 D2  
 29 00 00 00 00 00 02 64 02  
 29 00 00 00 00 00 02 65 F5  
 29 00 00 00 00 00 02 66 03  
 29 00 00 00 00 00 02 67 22  
 29 00 00 00 00 00 02 68 03  
 29 00 00 00 00 00 02 69 30  
 29 00 00 00 00 00 02 6A 03  
 29 00 00 00 00 00 02 6B 40  
 29 00 00 00 00 00 02 6C 03  
 29 00 00 00 00 00 02 6D 52  
 29 00 00 00 00 00 02 6E 03  
 29 00 00 00 00 00 02 6F 65  
 29 00 00 00 00 00 02 70 03  
 29 00 00 00 00 00 02 71 7D  
 29 00 00 00 00 00 02 72 03  
 29 00 00 00 00 00 02 73 A2  
 29 00 00 00 00 00 02 74 03  
 29 00 00 00 00 00 02 75 CF  
 29 00 00 00 00 00 02 76 03  
 29 00 00 00 00 00 02 77 E6  
 29 00 00 00 00 00 02 78 01
 29 01 00 00 00 00 02 79 01
 29 01 00 00 00 00 04 FF 78 07 03
 29 00 00 00 00 00 02 00 00  
 29 00 00 00 00 00 02 01 13  
 29 00 00 00 00 00 02 02 00  
 29 00 00 00 00 00 02 03 22  
 29 00 00 00 00 00 02 04 00  
 29 00 00 00 00 00 02 05 3C  
 29 00 00 00 00 00 02 06 00  
 29 00 00 00 00 00 02 07 52  
 29 00 00 00 00 00 02 08 00  
 29 00 00 00 00 00 02 09 66  
 29 00 00 00 00 00 02 0A 00  
 29 00 00 00 00 00 02 0B 77  
 29 00 00 00 00 00 02 0C 00  
 29 00 00 00 00 00 02 0D 88  
 29 00 00 00 00 00 02 0E 00  
 29 00 00 00 00 00 02 0F 97  
 29 00 00 00 00 00 02 10 00  
 29 00 00 00 00 00 02 11 A4  
 29 00 00 00 00 00 02 12 00  
 29 00 00 00 00 00 02 13 D4  
 29 00 00 00 00 00 02 14 00  
 29 00 00 00 00 00 02 15 FC  
 29 00 00 00 00 00 02 16 01  
 29 00 00 00 00 00 02 17 3B  
 29 00 00 00 00 00 02 18 01  
 29 00 00 00 00 00 02 19 6E  
 29 00 00 00 00 00 02 1A 01  
 29 00 00 00 00 00 02 1B BF  
 29 00 00 00 00 00 02 1C 01  
 29 00 00 00 00 00 02 1D FF  
 29 00 00 00 00 00 02 1E 02  
 29 00 00 00 00 00 02 1F 01  
 29 00 00 00 00 00 02 20 02  
 29 00 00 00 00 00 02 21 3A  
 29 00 00 00 00 00 02 22 02  
 29 00 00 00 00 00 02 23 78  
 29 00 00 00 00 00 02 24 02  
 29 00 00 00 00 00 02 25 A1  
 29 00 00 00 00 00 02 26 02  
 29 00 00 00 00 00 02 27 D9  
 29 00 00 00 00 00 02 28 02  
 29 00 00 00 00 00 02 29 FE  
 29 00 00 00 00 00 02 2A 03  
 29 00 00 00 00 00 02 2B 2E  
 29 00 00 00 00 00 02 2C 03  
 29 00 00 00 00 00 02 2D 3C  
 29 00 00 00 00 00 02 2E 03  
 29 00 00 00 00 00 02 2F 4B  
 29 00 00 00 00 00 02 30 03  
 29 00 00 00 00 00 02 31 5B  
 29 00 00 00 00 00 02 32 03  
 29 00 00 00 00 00 02 33 6F  
 29 00 00 00 00 00 02 34 03  
 29 00 00 00 00 00 02 35 86  
 29 00 00 00 00 00 02 36 03  
 29 00 00 00 00 00 02 37 A7  
 29 00 00 00 00 00 02 38 03  
 29 00 00 00 00 00 02 39 D1  
 29 00 00 00 00 00 02 3A 03  
 29 00 00 00 00 00 02 3B E6  
 29 00 00 00 00 00 02 3C 00  
 29 00 00 00 00 00 02 3D 13  
 29 00 00 00 00 00 02 3E 00  
 29 00 00 00 00 00 02 3F 22  
 29 00 00 00 00 00 02 40 00  
 29 00 00 00 00 00 02 41 3C  
 29 00 00 00 00 00 02 42 00  
 29 00 00 00 00 00 02 43 52  
 29 00 00 00 00 00 02 44 00  
 29 00 00 00 00 00 02 45 66  
 29 00 00 00 00 00 02 46 00  
 29 00 00 00 00 00 02 47 77  
 29 00 00 00 00 00 02 48 00  
 29 00 00 00 00 00 02 49 88  
 29 00 00 00 00 00 02 4A 00  
 29 00 00 00 00 00 02 4B 97  
 29 00 00 00 00 00 02 4C 00  
 29 00 00 00 00 00 02 4D A4  
 29 00 00 00 00 00 02 4E 00  
 29 00 00 00 00 00 02 4F D4  
 29 00 00 00 00 00 02 50 00  
 29 00 00 00 00 00 02 51 FC  
 29 00 00 00 00 00 02 52 01  
 29 00 00 00 00 00 02 53 3B  
 29 00 00 00 00 00 02 54 01  
 29 00 00 00 00 00 02 55 6E  
 29 00 00 00 00 00 02 56 01  
 29 00 00 00 00 00 02 57 BF  
 29 00 00 00 00 00 02 58 01  
 29 00 00 00 00 00 02 59 FF  
 29 00 00 00 00 00 02 5A 02  
 29 00 00 00 00 00 02 5B 01  
 29 00 00 00 00 00 02 5C 02  
 29 00 00 00 00 00 02 5D 3A  
 29 00 00 00 00 00 02 5E 02  
 29 00 00 00 00 00 02 5F 78  
 29 00 00 00 00 00 02 60 02  
 29 00 00 00 00 00 02 61 A1  
 29 00 00 00 00 00 02 62 02  
 29 00 00 00 00 00 02 63 D9  
 29 00 00 00 00 00 02 64 02  
 29 00 00 00 00 00 02 65 FE  
 29 00 00 00 00 00 02 66 03  
 29 00 00 00 00 00 02 67 2E  
 29 00 00 00 00 00 02 68 03  
 29 00 00 00 00 00 02 69 3C  
 29 00 00 00 00 00 02 6A 03  
 29 00 00 00 00 00 02 6B 4B  
 29 00 00 00 00 00 02 6C 03  
 29 00 00 00 00 00 02 6D 5B  
 29 00 00 00 00 00 02 6E 03  
 29 00 00 00 00 00 02 6F 6F  
 29 00 00 00 00 00 02 70 03  
 29 00 00 00 00 00 02 71 86  
 29 00 00 00 00 00 02 72 03  
 29 00 00 00 00 00 02 73 A7  
 29 00 00 00 00 00 02 74 03  
 29 00 00 00 00 00 02 75 D1  
 29 00 00 00 00 00 02 76 03  
 29 00 00 00 00 00 02 77 E6  
 29 00 00 00 00 00 02 78 01
 29 01 00 00 00 00 02 79 01
 29 01 00 00 00 00 04 FF 78 07 04
 29 00 00 00 00 00 02 00 00  
 29 00 00 00 00 00 02 01 0D  
 29 00 00 00 00 00 02 02 00  
 29 00 00 00 00 00 02 03 1C  
 29 00 00 00 00 00 02 04 00  
 29 00 00 00 00 00 02 05 35  
 29 00 00 00 00 00 02 06 00  
 29 00 00 00 00 00 02 07 4C  
 29 00 00 00 00 00 02 08 00  
 29 00 00 00 00 00 02 09 5F  
 29 00 00 00 00 00 02 0A 00  
 29 00 00 00 00 00 02 0B 71  
 29 00 00 00 00 00 02 0C 00  
 29 00 00 00 00 00 02 0D 82  
 29 00 00 00 00 00 02 0E 00  
 29 00 00 00 00 00 02 0F 91  
 29 00 00 00 00 00 02 10 00  
 29 00 00 00 00 00 02 11 9E  
 29 00 00 00 00 00 02 12 00  
 29 00 00 00 00 00 02 13 CF  
 29 00 00 00 00 00 02 14 00  
 29 00 00 00 00 00 02 15 F7  
 29 00 00 00 00 00 02 16 01  
 29 00 00 00 00 00 02 17 38  
 29 00 00 00 00 00 02 18 01  
 29 00 00 00 00 00 02 19 6B  
 29 00 00 00 00 00 02 1A 01  
 29 00 00 00 00 00 02 1B BD  
 29 00 00 00 00 00 02 1C 01  
 29 00 00 00 00 00 02 1D FD  
 29 00 00 00 00 00 02 1E 01  
 29 00 00 00 00 00 02 1F FF  
 29 00 00 00 00 00 02 20 02  
 29 00 00 00 00 00 02 21 38  
 29 00 00 00 00 00 02 22 02  
 29 00 00 00 00 00 02 23 75  
 29 00 00 00 00 00 02 24 02  
 29 00 00 00 00 00 02 25 9D  
 29 00 00 00 00 00 02 26 02  
 29 00 00 00 00 00 02 27 D6  
 29 00 00 00 00 00 02 28 02  
 29 00 00 00 00 00 02 29 FF  
 29 00 00 00 00 00 02 2A 03  
 29 00 00 00 00 00 02 2B 3F  
 29 00 00 00 00 00 02 2C 03  
 29 00 00 00 00 00 02 2D 4B  
 29 00 00 00 00 00 02 2E 03  
 29 00 00 00 00 00 02 2F 59  
 29 00 00 00 00 00 02 30 03  
 29 00 00 00 00 00 02 31 67  
 29 00 00 00 00 00 02 32 03  
 29 00 00 00 00 00 02 33 79  
 29 00 00 00 00 00 02 34 03  
 29 00 00 00 00 00 02 35 8B  
 29 00 00 00 00 00 02 36 03  
 29 00 00 00 00 00 02 37 A9  
 29 00 00 00 00 00 02 38 03  
 29 00 00 00 00 00 02 39 D2  
 29 00 00 00 00 00 02 3A 03  
 29 00 00 00 00 00 02 3B E6  
 29 00 00 00 00 00 02 3C 00  
 29 00 00 00 00 00 02 3D 0D  
 29 00 00 00 00 00 02 3E 00  
 29 00 00 00 00 00 02 3F 1C  
 29 00 00 00 00 00 02 40 00  
 29 00 00 00 00 00 02 41 35  
 29 00 00 00 00 00 02 42 00  
 29 00 00 00 00 00 02 43 4C  
 29 00 00 00 00 00 02 44 00  
 29 00 00 00 00 00 02 45 5F  
 29 00 00 00 00 00 02 46 00  
 29 00 00 00 00 00 02 47 71  
 29 00 00 00 00 00 02 48 00  
 29 00 00 00 00 00 02 49 82  
 29 00 00 00 00 00 02 4A 00  
 29 00 00 00 00 00 02 4B 91  
 29 00 00 00 00 00 02 4C 00  
 29 00 00 00 00 00 02 4D 9E  
 29 00 00 00 00 00 02 4E 00  
 29 00 00 00 00 00 02 4F CF  
 29 00 00 00 00 00 02 50 00  
 29 00 00 00 00 00 02 51 F7  
 29 00 00 00 00 00 02 52 01  
 29 00 00 00 00 00 02 53 38  
 29 00 00 00 00 00 02 54 01  
 29 00 00 00 00 00 02 55 6B  
 29 00 00 00 00 00 02 56 01  
 29 00 00 00 00 00 02 57 BD  
 29 00 00 00 00 00 02 58 01  
 29 00 00 00 00 00 02 59 FD  
 29 00 00 00 00 00 02 5A 01  
 29 00 00 00 00 00 02 5B FF  
 29 00 00 00 00 00 02 5C 02  
 29 00 00 00 00 00 02 5D 38  
 29 00 00 00 00 00 02 5E 02  
 29 00 00 00 00 00 02 5F 75  
 29 00 00 00 00 00 02 60 02  
 29 00 00 00 00 00 02 61 9D  
 29 00 00 00 00 00 02 62 02  
 29 00 00 00 00 00 02 63 D6  
 29 00 00 00 00 00 02 64 02  
 29 00 00 00 00 00 02 65 FF  
 29 00 00 00 00 00 02 66 03  
 29 00 00 00 00 00 02 67 3F  
 29 00 00 00 00 00 02 68 03  
 29 00 00 00 00 00 02 69 4B  
 29 00 00 00 00 00 02 6A 03  
 29 00 00 00 00 00 02 6B 59  
 29 00 00 00 00 00 02 6C 03  
 29 00 00 00 00 00 02 6D 67  
 29 00 00 00 00 00 02 6E 03  
 29 00 00 00 00 00 02 6F 79  
 29 00 00 00 00 00 02 70 03  
 29 00 00 00 00 00 02 71 8B  
 29 00 00 00 00 00 02 72 03  
 29 00 00 00 00 00 02 73 A9  
 29 00 00 00 00 00 02 74 03  
 29 00 00 00 00 00 02 75 D2  
 29 00 00 00 00 00 02 76 03  
 29 00 00 00 00 00 02 77 E6  
 29 00 00 00 00 00 02 78 01
 29 01 00 00 00 00 02 79 01
 29 01 00 00 00 00 04 FF 78 07 05
 29 01 00 00 00 00 02 00 17
 29 01 00 00 00 00 02 01 17
 29 01 00 00 00 00 02 02 17
 29 01 00 00 00 00 02 03 60
 29 01 00 00 00 00 02 04 20
 29 01 00 00 00 00 04 FF 78 07 07
 29 01 00 00 00 00 02 99 00
 29 01 00 00 00 00 02 9A 00
 29 01 00 00 00 00 02 A8 12
 29 01 00 00 00 00 04 FF 78 07 00
29 01 00 00 00 00 02 35 00
29 01 00 00 00 00 03 51 0F FF
29 01 00 00 00 00 02 53 2C
29 01 00 00 00 00 02 55 01

				05 01 00 00 78 00 02 11 00
				29 01 00 00 00 00 04 FF 78 07 06
				29 01 00 00 00 00 02 E3 00
				29 01 00 00 00 00 04 FF 78 07 00
				05 01 00 00 0A 00 02 29 00];
		qcom,mdss-dsi-off-command = [05 01 00 00 32 00 02 28 00
					05 01 00 00 78 00 02 10 00];
		qcom,mdss-dsi-cabc-ui-command = [29 01 00 00 00 00 02 55 01];
		qcom,mdss-dsi-cabc-mv-command = [29 01 00 00 00 00 02 55 03];
		qcom,mdss-dsi-cabc-dis-command = [29 01 00 00 00 00 02 55 00];
		qcom,mdss-dsi-on-command-state = "dsi_lp_mode";
		qcom,mdss-dsi-off-command-state = "dsi_hs_mode";
		qcom,mdss-dsi-h-sync-pulse = <1>;
		qcom,mdss-dsi-traffic-mode = "burst_mode";
		qcom,mdss-dsi-bllp-eof-power-mode;
		qcom,mdss-dsi-bllp-power-mode;
                qcom,esd-check-enabled;
		qcom,mdss-dsi-panel-status-read-length = <4>;
		qcom,mdss-dsi-panel-status-valid-params = <1>; 
		qcom,mdss-dsi-panel-max-error-count = <30>;
		qcom,mdss-dsi-panel-status-command = [06 01 00 01 05 00 01 0A];
		qcom,mdss-dsi-panel-status-command-state = "dsi_lp_mode";
		qcom,mdss-dsi-panel-status-check-mode = "reg_read"; 
		qcom,mdss-dsi-panel-status-value = <0x9c>; 		
		qcom,mdss-dsi-lane-0-state;
		qcom,mdss-dsi-lane-1-state;
		qcom,mdss-dsi-lane-2-state;
		qcom,mdss-dsi-lane-3-state;
		qcom,mdss-dsi-panel-timings = [F3 3A 26 00 6A 6E 2C 3E 2F 03 04 00];
		qcom,mdss-dsi-t-clk-post = <0x02>;
		qcom,mdss-dsi-t-clk-pre = <0x2D>;
		qcom,mdss-dsi-bl-min-level = <1>;
		qcom,mdss-dsi-bl-max-level = <4095>;
		qcom,mdss-dsi-dma-trigger = "trigger_sw";
		qcom,mdss-dsi-mdp-trigger = "none";
                qcom,mdss-dsi-lp11-init;
		qcom,mdss-dsi-bl-pmic-control-type = "bl_ctrl_wled";
		qcom,mdss-dsi-reset-sequence = <0 10>, <1 10>;
		qcom,mdss-pan-physical-width-dimension = <62>;
		qcom,mdss-pan-physical-height-dimension = <110>;
	};
};
