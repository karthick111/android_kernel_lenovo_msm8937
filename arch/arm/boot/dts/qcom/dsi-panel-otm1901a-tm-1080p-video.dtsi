/* Copyright (c) 2014, The Linux Foundation. All rights reserved.
 *
 * This program is free software; you can redistribute it and/or modify
 * it under the terms of the GNU General Public License version 2 and
 * only version 2 as published by the Free Software Foundation.
 *
 * This program is distributed in the hope that it will be useful,
 * but WITHOUT ANY WARRANTY; without even the implied warranty of
 * MERCHANTABILITY or FITNESS FOR A PARTICULAR PURPOSE.  See the
 * GNU General Public License for more details.
 */

/*---------------------------------------------------------------------------
 * This file is autogenerated file using gcdb parser. Please do not edit it.
 * Update input XML file to add a new entry or update variable in this file
 * VERSION = "1.0"
 *---------------------------------------------------------------------------*/
&mdss_mdp {
	dsi_otm1901a_tm_1080p_video: qcom,mdss_dsi_otm1901a_tm_1080p_video {
		qcom,mdss-dsi-panel-name = "otm1901a_1080p_video_TianMa";
		qcom,mdss-dsi-panel-type = "dsi_video_mode";
		qcom,mdss-dsi-panel-destination = "display_1";
		qcom,mdss-dsi-panel-framerate = <60>;
		qcom,mdss-dsi-virtual-channel-id = <0>;
		qcom,mdss-dsi-stream = <0>;
		qcom,mdss-dsi-panel-width = <1080>;
		qcom,mdss-dsi-panel-height = <1920>;
		qcom,mdss-dsi-h-front-porch = <252>;
		qcom,mdss-dsi-h-back-porch = <40>;
		qcom,mdss-dsi-h-pulse-width = <4>;
		qcom,mdss-dsi-h-sync-skew = <0>;
		qcom,mdss-dsi-v-back-porch = <9>;
		qcom,mdss-dsi-v-front-porch = <14>;
		qcom,mdss-dsi-v-pulse-width = <2>;
		qcom,mdss-dsi-h-left-border = <0>;
		qcom,mdss-dsi-h-right-border = <0>;
		qcom,mdss-dsi-v-top-border = <0>;
		qcom,mdss-dsi-v-bottom-border = <0>;
		qcom,mdss-dsi-bpp = <24>;
		qcom,mdss-dsi-color-order = "rgb_swap_rgb";
		qcom,mdss-dsi-underflow-color = <0xff>;
		qcom,mdss-dsi-border-color = <0>;
		qcom,mdss-dsi-on-command = [29 00 00 00 00 00 02 00 00
				29 00 00 00 00 00 04 FF 19 01 01
				29 00 00 00 00 00 02 00 80
				29 00 00 00 00 00 03 FF 19 01
				29 00 00 00 00 00 02 00 00
				29 00 00 00 00 00 02 1C 33
				29 00 00 00 00 00 02 00 0A
				29 00 00 00 00 00 02 C1 00
				29 00 00 00 00 00 02 00 00
				29 00 00 00 00 00 02 35 00
				29 00 00 00 00 00 02 51 FF
				29 00 00 00 00 00 02 53 24
				29 00 00 00 00 00 02 55 01
                                29 00 00 00 00 00 02 00 00
				29 00 00 00 00 00 04 FF FF FF FF
				05 01 00 00 78 00 02 11 00
				05 01 00 00 0A 00 02 29 00
                                29 01 00 00 00 00 02 00 00
				29 01 00 00 00 00 03 99 11 11
                ];
		qcom,mdss-dsi-off-command = [
                                        29 01 00 00 00 00 02 00 00
				        29 01 00 00 00 00 03 99 95 27
                                        05 01 00 00 32 00 02 28 00
					05 01 00 00 78 00 02 10 00
                                        29 01 00 00 00 00 02 00 00
				        29 01 00 00 00 00 03 99 11 11
                                        ];
		qcom,mdss-dsi-cabc-ui-command = [29 01 00 00 00 00 02 55 01];
		qcom,mdss-dsi-cabc-mv-command = [29 01 00 00 00 00 02 55 03];
		qcom,mdss-dsi-cabc-dis-command = [29 01 00 00 00 00 02 55 00];
		qcom,mdss-dsi-on-command-state = "dsi_lp_mode";
		qcom,mdss-dsi-off-command-state = "dsi_lp_mode";
		qcom,mdss-dsi-h-sync-pulse = <1>;
		qcom,mdss-dsi-traffic-mode = "burst_mode";
		qcom,mdss-dsi-bllp-eof-power-mode;
		qcom,mdss-dsi-bllp-power-mode;
                qcom,esd-check-enabled;
		qcom,mdss-dsi-panel-status-read-length = <1 1>;
		qcom,mdss-dsi-panel-max-error-count = <1>;
		qcom,mdss-dsi-panel-status-command = [06 01 00 01 05 00 02 0A 08
                                                       06 01 00 01 05 00 02 0B 08];
		qcom,mdss-dsi-panel-status-command-state = "dsi_hs_mode";
		qcom,mdss-dsi-panel-status-check-mode = "reg_read"; 
		qcom,mdss-dsi-panel-status-value = <0x9c>,
                                                   <0x00>;
		qcom,mdss-dsi-lane-0-state;
		qcom,mdss-dsi-lane-1-state;
		qcom,mdss-dsi-lane-2-state;
		qcom,mdss-dsi-lane-3-state;
		qcom,mdss-dsi-hfp-power-mode;
		qcom,mdss-dsi-panel-timings = [FB 3C 28 00 6E 72 2E 40 30 03 04 00];
		qcom,mdss-dsi-t-clk-post = <0x02>;
		qcom,mdss-dsi-t-clk-pre = <0x2D>;
		qcom,mdss-dsi-bl-min-level = <1>;
		qcom,mdss-dsi-bl-max-level = <4095>;
		qcom,mdss-dsi-dma-trigger = "trigger_sw";
		qcom,mdss-dsi-mdp-trigger = "none";
                qcom,mdss-dsi-lp11-init;
		qcom,mdss-dsi-bl-pmic-control-type = "bl_ctrl_wled";
		qcom,mdss-dsi-reset-sequence = <1 2>, <0 1>, <1 6>;
		qcom,mdss-pan-physical-width-dimension = <62>;
		qcom,mdss-pan-physical-height-dimension = <110>;
	};
};
