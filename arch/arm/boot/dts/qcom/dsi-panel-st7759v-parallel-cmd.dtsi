/* Copyright (c) 2014-2019, The Linux Foundation. All rights reserved.
 *
 * This program is free software; you can redistribute it and/or modify
 * it under the terms of the GNU General Public License version 2 and
 * only version 2 as published by the Free Software Foundation.
 *
 * This program is distributed in the hope that it will be useful,
 * but WITHOUT ANY WARRANTY; without even the implied warranty of
 * MERCHANTABILITY or FITNESS FOR A PARTICULAR PURPOSE.  See the
 * GNU General Public License for more details.
 */

&mdss_mdp {
	dsi_st7759v_parallel_cmd: qcom,mdss_dsi_st7759v_parallel_cmd {
		qcom,mdss-dsi-panel-name =
			"ST7759v parallel command mode dsi panel";
		qcom,mdss-dsi-panel-controller = <&mdss_dsi0>;
		qcom,mdss-dsi-panel-type = "dsi_video_mode";
		qcom,mdss-dsi-panel-destination = "display_1";
		qcom,mdss-dsi-panel-framerate = <60>;//modified
		qcom,mdss-dsi-virtual-channel-id = <0>;
		qcom,mdss-dsi-stream = <0>;

		qcom,mdss-dsi-panel-width = <240>;
		qcom,mdss-dsi-panel-height = <320>;
		/*For 18 bit panel interface */
		qcom,mdss-dsi-h-front-porch = <32>;
		qcom,mdss-dsi-h-back-porch = <32>;
		qcom,mdss-dsi-h-pulse-width = <32>;
		qcom,mdss-dsi-h-sync-skew = <0>;
		qcom,mdss-dsi-v-front-porch = <8>;
		qcom,mdss-dsi-v-back-porch = <8>;
		qcom,mdss-dsi-v-pulse-width = <8>;
		/*For 16 bit panel interface
		qcom,mdss-dsi-h-front-porch = <16>;
		qcom,mdss-dsi-h-back-porch = <10>;
		qcom,mdss-dsi-h-pulse-width = <10>;
		qcom,mdss-dsi-v-front-porch = <16>;
		qcom,mdss-dsi-v-back-porch = <16>;
		qcom,mdss-dsi-v-pulse-width = <8>;*/
		qcom,mdss-dsi-h-left-border = <0>;
		qcom,mdss-dsi-h-right-border = <0>;
		qcom,mdss-dsi-v-top-border = <0>;
		qcom,mdss-dsi-v-bottom-border = <0>;
		qcom,mdss-dsi-bpp = <18>;
		qcom,mdss-dsi-underflow-color = <0xff>;
		qcom,mdss-dsi-border-color = <0>;
		qcom,mdss-dsi-on-command = [
			05 01 00 00 78 00 02 11 00
			39 01 00 00 00 00 02 36 00
			39 01 00 00 00 00 02 3A 06 //05 for rgb565
			39 01 00 00 00 00 06 B2 0C 0C 00 33 33
			39 01 00 00 00 00 02 B7 35
			39 01 00 00 00 00 02 BB 55
			39 01 00 00 00 00 02 C0 2C
			39 01 00 00 00 00 02 C2 01
			39 01 00 00 00 00 02 C3 17
			39 01 00 00 00 00 02 C4 20
			39 01 00 00 00 00 02 C6 0F
			39 01 00 00 00 00 03 D0 A4 A1
			39 01 00 00 00 00 0F E0 D0 00 14 15 13 2C 42 43 4E 09 16 14 18 21
			39 01 00 00 00 00 0F E1 D0 00 14 15 13 0B 43 55 53 0C 17 14 23 20
			05 01 00 00 32 00 01 29
			05 01 00 00 32 00 01 2C
			];
		qcom,mdss-dsi-off-command = [
					05 01 00 00 32 00 02 2C 00
					05 01 00 00 32 00 02 28 00
					05 01 00 00 78 00 02 10 00
					];

		qcom,mdss-dsi-h-sync-pulse = <1>;
		qcom,mdss-dsi-traffic-mode =
			"non_burst_sync_pulse";	//burst_mode";
		qcom,mdss-dsi-lane-map = <0>;
		qcom,mdss-dsi-on-command-state = "dsi_lp_mode";
		qcom,mdss-dsi-off-command-state = "dsi_lp_mode";
		qcom,mdss-dsi-init-delay-us = <7000>;
		qcom,mdss-dsi-lp11-init;
		qcom,mdss-dsi-bllp-eof-power-mode;
		qcom,mdss-dsi-bllp-power-mode;
		qcom,mdss-dsi-lane-0-state;
		qcom,mdss-dsi-pixel-packing = "loose";
		/*For 16 bit panel interface
		qcom,mdss-dsi-panel-timings =
			[ED 0A 02 00 20 24 06 0C 09 03 04 00];// framerate 60 */
		/* 18 bpp framerate 60 */
		qcom,mdss-dsi-panel-timings =
			[F3 08 04 00 24 26 08 0C 09 03 04 00];
		qcom,mdss-dsi-t-clk-post = <0x5>;
		qcom,mdss-dsi-t-clk-pre = <0x36>;
		qcom,mdss-dsi-bl-min-level = <0>;
		qcom,mdss-dsi-bl-max-level = <255>;
		qcom,mdss-dsi-dma-trigger = "trigger_sw";
		qcom,mdss-dsi-mdp-trigger = "none";
		qcom,mdss-dsi-bl-pmic-control-type = "bl_thirdparty_ctrl";
		qcom,mdss-dsi-reset-sequence = <1 20>, <0 1>, <1 20>;
		qcom,mdss-pan-physical-width-dimension = <39>;
		qcom,mdss-pan-physical-height-dimension = <52>;
	};
};
