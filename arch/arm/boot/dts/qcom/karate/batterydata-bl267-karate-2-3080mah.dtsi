
qcom,bl267-karate-2-3080mah {
	/* #2495463_Lenovo_BL267_3080mAh_averaged_MasterSlave_Jul18th2016*/
	qcom,max-voltage-uv = <4400000>;
	qcom,nom-batt-capacity-mah = <3080>;
	qcom,batt-id-kohm = <47>;
	qcom,battery-beta = <3435>;
	qcom,battery-type = "2495463_lenovo_bl267_3080mah_averaged_masterslave_jul18th2016";
	qcom,chg-rslow-comp-c1 = <2142335>;
	qcom,chg-rslow-comp-c2 = <2144462>;
	qcom,chg-rs-to-rslow = <843668>;
	qcom,chg-rslow-comp-thr = <0x99>;
	qcom,checksum = <0x9CBD>;
	qcom,gui-version = "PMI8950GUI - 2.0.0.16";
	qcom,fg-profile-data = [
		 D3 83 43 7C 
		 86 80 F7 75 
		 38 83 E4 68 
		 73 80 C9 8C 
		 2A 82 52 98 
		 8A B5 DB C0 
		 52 18 EA 82 
		 8B 73 85 6F 
		 60 6B 1E 83 
		 BA 7A 1E 8C 
		 03 88 20 82 
		 D4 99 F3 BC 
		 0B CA 8E 0D 
		 4B 0C 39 60 
		 14 70 9F FD 
		 69 42 FA 47 
		 E5 3D 00 00 
		 B9 45 32 41 
		 0A 44 00 00 
		 00 00 00 00 
		 00 00 00 00 
		 6F 70 E7 6A 
		 33 7D 76 7A 
		 84 7C DB 70 
		 9D 5F C3 81 
		 0F 7C DF 6B 
		 8F 68 FD B0 
		 23 6F 63 55 
		 5D A0 71 0C 
		 28 00 FF 36 
		 F0 11 30 03 
		 00 00 00 0C 
	];
};
