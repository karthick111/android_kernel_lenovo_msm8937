/* Copyright (c) 2014, The Linux Foundation. All rights reserved.
 *
 * This program is free software; you can redistribute it and/or modify
 * it under the terms of the GNU General Public License version 2 and
 * only version 2 as published by the Free Software Foundation.
 *
 * This program is distributed in the hope that it will be useful,
 * but WITHOUT ANY WARRANTY; without even the implied warranty of
 * MERCHANTABILITY or FITNESS FOR A PARTICULAR PURPOSE.  See the
 * GNU General Public License for more details.
 */

/*---------------------------------------------------------------------------
 * This file is autogenerated file using gcdb parser. Please do not edit it.
 * Update input XML file to add a new entry or update variable in this file
 * VERSION = "1.0"
 *---------------------------------------------------------------------------*/
&mdss_mdp {
        dsi_ili7807d_yas_2nd_1080p_video: qcom,mdss_dsi_ili7807d_yas_2nd_1080p_video {
		qcom,mdss-dsi-panel-name = "ili7807d_2nd_1080p_video_YAS";
                qcom,mdss-dsi-panel-type = "dsi_video_mode";
		qcom,mdss-dsi-panel-destination = "display_1";
		qcom,mdss-dsi-panel-framerate = <0x3c>;
		qcom,mdss-dsi-virtual-channel-id = <0x0>;
		qcom,mdss-dsi-stream = <0x0>;
		qcom,mdss-dsi-panel-width = <0x438>;
		qcom,mdss-dsi-panel-height = <0x780>;
		qcom,mdss-dsi-h-front-porch = <0xfc>;
		qcom,mdss-dsi-h-back-porch = <0x28>;
		qcom,mdss-dsi-h-pulse-width = <0x4>;
		qcom,mdss-dsi-h-sync-skew = <0x0>;
		qcom,mdss-dsi-v-back-porch = <0xa>;
		qcom,mdss-dsi-v-front-porch = <0xe>;
		qcom,mdss-dsi-v-pulse-width = <0x4>;
		qcom,mdss-dsi-h-left-border = <0x0>;
		qcom,mdss-dsi-h-right-border = <0x0>;
		qcom,mdss-dsi-v-top-border = <0x0>;
		qcom,mdss-dsi-v-bottom-border = <0x0>;
		qcom,mdss-dsi-bpp = <0x18>;
		qcom,mdss-dsi-color-order = "rgb_swap_rgb";
		qcom,mdss-dsi-underflow-color = <0xff>;
	        qcom,mdss-dsi-border-color = <0x0>;
		qcom,mdss-dsi-on-command = [29 01 00 00 00 00 04 ff 78 07 01 29 00 00 00 00 00 02 42 11 29 00 00 00 00 00 02 43 a8 29 00 00 00 00 00 02 44 9e 29 00 00 00 00 00 02 45 1b 29 00 00 00 00 00 02 46 10 29 00 00 00 00 00 02 4a 15 29 00 00 00 00 00 02 4b 15 29 00 00 00 00 00 02 50 55 29 00 00 00 00 00 02 51 55 29 00 00 00 00 00 02 5a 33 29 00 00 00 00 00 02 a2 01 29 00 00 00 00 00 02 a3 13 29 01 00 00 00 00 02 b3 70 29 01 00 00 00 00 02 b4 70 29 01 00 00 00 00 04 ff 78 07 01 29 00 00 00 00 00 02 22 06 29 00 00 00 00 00 02 36 00 29 00 00 00 00 00 02 63 05 29 00 00 00 00 00 02 64 00 29 00 00 00 00 00 02 6c 40 29 01 00 00 00 00 04 ff 78 07 06 29 00 00 00 00 00 02 00 41 29 00 00 00 00 00 02 01 04 29 00 00 00 00 00 02 02 08 29 00 00 00 00 00 02 03 0a 29 00 00 00 00 00 02 04 00 29 00 00 00 00 00 02 05 00 29 00 00 00 00 00 02 06 00 29 00 00 00 00 00 02 07 00 29 00 00 00 00 00 02 08 01 29 00 00 00 00 00 02 09 08 29 00 00 00 00 00 02 0a 70 29 00 00 00 00 00 02 0b 00 29 00 00 00 00 00 02 0c 08 29 00 00 00 00 00 02 0d 08 29 00 00 00 00 00 02 0e 0a 29 00 00 00 00 00 02 0f 0a 29 00 00 00 00 00 02 10 00 29 00 00 00 00 00 02 11 00 29 00 00 00 00 00 02 12 00 29 00 00 00 00 00 02 13 00 29 00 00 00 00 00 02 14 00 29 00 00 00 00 00 02 15 00 29 00 00 00 00 00 02 31 08 29 00 00 00 00 00 02 32 10 29 00 00 00 00 00 02 33 12 29 00 00 00 00 00 02 34 14 29 00 00 00 00 00 02 35 16 29 00 00 00 00 00 02 36 07 29 00 00 00 00 00 02 37 07 29 00 00 00 00 00 02 38 07 29 00 00 00 00 00 02 39 23 29 00 00 00 00 00 02 3a 22 29 00 00 00 00 00 02 3b 07 29 00 00 00 00 00 02 3c 07 29 00 00 00 00 00 02 3d 07 29 00 00 00 00 00 02 3e 28 29 00 00 00 00 00 02 3f 29 29 00 00 00 00 00 02 40 2a 29 00 00 00 00 00 02 41 09 29 00 00 00 00 00 02 42 11 29 00 00 00 00 00 02 43 13 29 00 00 00 00 00 02 44 15 29 00 00 00 00 00 02 45 17 29 00 00 00 00 00 02 46 07 29 00 00 00 00 00 02 47 07 29 00 00 00 00 00 02 48 07 29 00 00 00 00 00 02 49 22 29 00 00 00 00 00 02 4a 22 29 00 00 00 00 00 02 4b 07 29 00 00 00 00 00 02 4c 07 29 00 00 00 00 00 02 4d 07 29 00 00 00 00 00 02 4e 28 29 00 00 00 00 00 02 4f 29 29 00 00 00 00 00 02 50 2a 29 00 00 00 00 00 02 61 09 29 00 00 00 00 00 02 62 17 29 00 00 00 00 00 02 63 15 29 00 00 00 00 00 02 64 13 29 00 00 00 00 00 02 65 11 29 00 00 00 00 00 02 66 07 29 00 00 00 00 00 02 67 07 29 00 00 00 00 00 02 68 07 29 00 00 00 00 00 02 69 23 29 00 00 00 00 00 02 6a 22 29 00 00 00 00 00 02 6b 07 29 00 00 00 00 00 02 6c 07 29 00 00 00 00 00 02 6d 07 29 00 00 00 00 00 02 6e 28 29 00 00 00 00 00 02 6f 29 29 00 00 00 00 00 02 70 2a 29 00 00 00 00 00 02 71 08 29 00 00 00 00 00 02 72 16 29 00 00 00 00 00 02 73 14 29 00 00 00 00 00 02 74 12 29 00 00 00 00 00 02 75 10 29 00 00 00 00 00 02 76 07 29 00 00 00 00 00 02 77 07 29 00 00 00 00 00 02 78 07 29 00 00 00 00 00 02 79 22 29 00 00 00 00 00 02 7a 22 29 00 00 00 00 00 02 7b 07 29 00 00 00 00 00 02 7c 07 29 00 00 00 00 00 02 7d 07 29 00 00 00 00 00 02 7e 28 29 00 00 00 00 00 02 7f 29 29 00 00 00 00 00 02 80 2a 29 00 00 00 00 00 02 97 11 29 00 00 00 00 00 02 e5 03 29 00 00 00 00 00 02 d0 01 29 00 00 00 00 00 02 d1 00 29 00 00 00 00 00 02 d2 01 29 00 00 00 00 00 02 d9 04 29 00 00 00 00 00 02 da 04 29 00 00 00 00 00 02 db 04 29 00 00 00 00 00 02 a0 08 29 00 00 00 00 00 02 a1 00 29 00 00 00 00 00 02 a2 08 29 00 00 00 00 00 02 a3 20 29 00 00 00 00 00 02 a6 11 29 00 00 00 00 00 02 a7 00 29 00 00 00 00 00 02 d2 01 29 00 00 00 00 00 02 d9 04 29 00 00 00 00 00 02 da 04 29 00 00 00 00 00 02 dd 55 29 00 00 00 00 00 04 ff 78 07 08 29 00 00 00 00 00 02 09 0e 29 01 00 00 00 00 04 ff 78 07 02 29 00 00 00 00 00 02 00 00 29 00 00 00 00 00 02 01 d9 29 00 00 00 00 00 02 02 00 29 00 00 00 00 00 02 03 e6 29 00 00 00 00 00 02 04 00 29 00 00 00 00 00 02 05 fc 29 00 00 00 00 00 02 06 01 29 00 00 00 00 00 02 07 0e 29 00 00 00 00 00 02 08 01 29 00 00 00 00 00 02 09 1d 29 00 00 00 00 00 02 0a 01 29 00 00 00 00 00 02 0b 2b 29 00 00 00 00 00 02 0c 01 29 00 00 00 00 00 02 0d 37 29 00 00 00 00 00 02 0e 01 29 00 00 00 00 00 02 0f 43 29 00 00 00 00 00 02 10 01 29 00 00 00 00 00 02 11 4d 29 00 00 00 00 00 02 12 01 29 00 00 00 00 00 02 13 71 29 00 00 00 00 00 02 14 01 29 00 00 00 00 00 02 15 8f 29 00 00 00 00 00 02 16 01 29 00 00 00 00 00 02 17 be 29 00 00 00 00 00 02 18 01 29 00 00 00 00 00 02 19 e5 29 00 00 00 00 00 02 1a 02 29 00 00 00 00 00 02 1b 23 29 00 00 00 00 00 02 1c 02 29 00 00 00 00 00 02 1d 56 29 00 00 00 00 00 02 1e 02 29 00 00 00 00 00 02 1f 58 29 00 00 00 00 00 02 20 02 29 00 00 00 00 00 02 21 88 29 00 00 00 00 00 02 22 02 29 00 00 00 00 00 02 23 bd 29 00 00 00 00 00 02 24 02 29 00 00 00 00 00 02 25 df 29 00 00 00 00 00 02 26 03 29 00 00 00 00 00 02 27 0b 29 00 00 00 00 00 02 28 03 29 00 00 00 00 00 02 29 28 29 00 00 00 00 00 02 2a 03 29 00 00 00 00 00 02 2b 4d 29 00 00 00 00 00 02 2c 03 29 00 00 00 00 00 02 2d 59 29 00 00 00 00 00 02 2e 03 29 00 00 00 00 00 02 2f 65 29 00 00 00 00 00 02 30 03 29 00 00 00 00 00 02 31 73 29 00 00 00 00 00 02 32 03 29 00 00 00 00 00 02 33 83 29 00 00 00 00 00 02 34 03 29 00 00 00 00 00 02 35 96 29 00 00 00 00 00 02 36 03 29 00 00 00 00 00 02 37 b1 29 00 00 00 00 00 02 38 03 29 00 00 00 00 00 02 39 d4 29 00 00 00 00 00 02 3a 03 29 00 00 00 00 00 02 3b e6 29 00 00 00 00 00 02 3c 00 29 00 00 00 00 00 02 3d d9 29 00 00 00 00 00 02 3e 00 29 00 00 00 00 00 02 3f e6 29 00 00 00 00 00 02 40 00 29 00 00 00 00 00 02 41 fc 29 00 00 00 00 00 02 42 01 29 00 00 00 00 00 02 43 0e 29 00 00 00 00 00 02 44 01 29 00 00 00 00 00 02 45 1d 29 00 00 00 00 00 02 46 01 29 00 00 00 00 00 02 47 2b 29 00 00 00 00 00 02 48 01 29 00 00 00 00 00 02 49 37 29 00 00 00 00 00 02 4a 01 29 00 00 00 00 00 02 4b 43 29 00 00 00 00 00 02 4c 01 29 00 00 00 00 00 02 4d 4d 29 00 00 00 00 00 02 4e 01 29 00 00 00 00 00 02 4f 71 29 00 00 00 00 00 02 50 01 29 00 00 00 00 00 02 51 8f 29 00 00 00 00 00 02 52 01 29 00 00 00 00 00 02 53 be 29 00 00 00 00 00 02 54 01 29 00 00 00 00 00 02 55 e5 29 00 00 00 00 00 02 56 02 29 00 00 00 00 00 02 57 23 29 00 00 00 00 00 02 58 02 29 00 00 00 00 00 02 59 56 29 00 00 00 00 00 02 5a 02 29 00 00 00 00 00 02 5b 58 29 00 00 00 00 00 02 5c 02 29 00 00 00 00 00 02 5d 88 29 00 00 00 00 00 02 5e 02 29 00 00 00 00 00 02 5f bd 29 00 00 00 00 00 02 60 02 29 00 00 00 00 00 02 61 df 29 00 00 00 00 00 02 62 03 29 00 00 00 00 00 02 63 0b 29 00 00 00 00 00 02 64 03 29 00 00 00 00 00 02 65 28 29 00 00 00 00 00 02 66 03 29 00 00 00 00 00 02 67 4d 29 00 00 00 00 00 02 68 03 29 00 00 00 00 00 02 69 59 29 00 00 00 00 00 02 6a 03 29 00 00 00 00 00 02 6b 65 29 00 00 00 00 00 02 6c 03 29 00 00 00 00 00 02 6d 73 29 00 00 00 00 00 02 6e 03 29 00 00 00 00 00 02 6f 83 29 00 00 00 00 00 02 70 03 29 00 00 00 00 00 02 71 96 29 00 00 00 00 00 02 72 03 29 00 00 00 00 00 02 73 b1 29 00 00 00 00 00 02 74 03 29 00 00 00 00 00 02 75 d4 29 00 00 00 00 00 02 76 03 29 00 00 00 00 00 02 77 e6 29 00 00 00 00 00 02 78 01 29 01 00 00 00 00 02 79 01 29 01 00 00 00 00 04 ff 78 07 03 29 00 00 00 00 00 02 00 00 29 00 00 00 00 00 02 01 de 29 00 00 00 00 00 02 02 00 29 00 00 00 00 00 02 03 ea 29 00 00 00 00 00 02 04 00 29 00 00 00 00 00 02 05 ff 29 00 00 00 00 00 02 06 01 29 00 00 00 00 00 02 07 0f 29 00 00 00 00 00 02 08 01 29 00 00 00 00 00 02 09 1e 29 00 00 00 00 00 02 0a 01 29 00 00 00 00 00 02 0b 2c 29 00 00 00 00 00 02 0c 01 29 00 00 00 00 00 02 0d 38 29 00 00 00 00 00 02 0e 01 29 00 00 00 00 00 02 0f 43 29 00 00 00 00 00 02 10 01 29 00 00 00 00 00 02 11 4d 29 00 00 00 00 00 02 12 01 29 00 00 00 00 00 02 13 71 29 00 00 00 00 00 02 14 01 29 00 00 00 00 00 02 15 8e 29 00 00 00 00 00 02 16 01 29 00 00 00 00 00 02 17 be 29 00 00 00 00 00 02 18 01 29 00 00 00 00 00 02 19 e5 29 00 00 00 00 00 02 1a 02 29 00 00 00 00 00 02 1b 23 29 00 00 00 00 00 02 1c 02 29 00 00 00 00 00 02 1d 57 29 00 00 00 00 00 02 1e 02 29 00 00 00 00 00 02 1f 58 29 00 00 00 00 00 02 20 02 29 00 00 00 00 00 02 21 88 29 00 00 00 00 00 02 22 02 29 00 00 00 00 00 02 23 be 29 00 00 00 00 00 02 24 02 29 00 00 00 00 00 02 25 df 29 00 00 00 00 00 02 26 03 29 00 00 00 00 00 02 27 0b 29 00 00 00 00 00 02 28 03 29 00 00 00 00 00 02 29 28 29 00 00 00 00 00 02 2a 03 29 00 00 00 00 00 02 2b 4d 29 00 00 00 00 00 02 2c 03 29 00 00 00 00 00 02 2d 58 29 00 00 00 00 00 02 2e 03 29 00 00 00 00 00 02 2f 64 29 00 00 00 00 00 02 30 03 29 00 00 00 00 00 02 31 72 29 00 00 00 00 00 02 32 03 29 00 00 00 00 00 02 33 82 29 00 00 00 00 00 02 34 03 29 00 00 00 00 00 02 35 95 29 00 00 00 00 00 02 36 03 29 00 00 00 00 00 02 37 b1 29 00 00 00 00 00 02 38 03 29 00 00 00 00 00 02 39 d4 29 00 00 00 00 00 02 3a 03 29 00 00 00 00 00 02 3b e6 29 00 00 00 00 00 02 3c 00 29 00 00 00 00 00 02 3d de 29 00 00 00 00 00 02 3e 00 29 00 00 00 00 00 02 3f ea 29 00 00 00 00 00 02 40 00 29 00 00 00 00 00 02 41 ff 29 00 00 00 00 00 02 42 01 29 00 00 00 00 00 02 43 0f 29 00 00 00 00 00 02 44 01 29 00 00 00 00 00 02 45 1e 29 00 00 00 00 00 02 46 01 29 00 00 00 00 00 02 47 2c 29 00 00 00 00 00 02 48 01 29 00 00 00 00 00 02 49 38 29 00 00 00 00 00 02 4a 01 29 00 00 00 00 00 02 4b 43 29 00 00 00 00 00 02 4c 01 29 00 00 00 00 00 02 4d 4d 29 00 00 00 00 00 02 4e 01 29 00 00 00 00 00 02 4f 71 29 00 00 00 00 00 02 50 01 29 00 00 00 00 00 02 51 8e 29 00 00 00 00 00 02 52 01 29 00 00 00 00 00 02 53 be 29 00 00 00 00 00 02 54 01 29 00 00 00 00 00 02 55 e5 29 00 00 00 00 00 02 56 02 29 00 00 00 00 00 02 57 23 29 00 00 00 00 00 02 58 02 29 00 00 00 00 00 02 59 57 29 00 00 00 00 00 02 5a 02 29 00 00 00 00 00 02 5b 58 29 00 00 00 00 00 02 5c 02 29 00 00 00 00 00 02 5d 88 29 00 00 00 00 00 02 5e 02 29 00 00 00 00 00 02 5f be 29 00 00 00 00 00 02 60 02 29 00 00 00 00 00 02 61 df 29 00 00 00 00 00 02 62 03 29 00 00 00 00 00 02 63 0b 29 00 00 00 00 00 02 64 03 29 00 00 00 00 00 02 65 28 29 00 00 00 00 00 02 66 03 29 00 00 00 00 00 02 67 4d 29 00 00 00 00 00 02 68 03 29 00 00 00 00 00 02 69 58 29 00 00 00 00 00 02 6a 03 29 00 00 00 00 00 02 6b 64 29 00 00 00 00 00 02 6c 03 29 00 00 00 00 00 02 6d 72 29 00 00 00 00 00 02 6e 03 29 00 00 00 00 00 02 6f 82 29 00 00 00 00 00 02 70 03 29 00 00 00 00 00 02 71 95 29 00 00 00 00 00 02 72 03 29 00 00 00 00 00 02 73 b1 29 00 00 00 00 00 02 74 03 29 00 00 00 00 00 02 75 d4 29 00 00 00 00 00 02 76 03 29 00 00 00 00 00 02 77 e6 29 00 00 00 00 00 02 78 01 29 01 00 00 00 00 02 79 01 29 01 00 00 00 00 04 ff 78 07 04 29 00 00 00 00 00 02 00 00 29 00 00 00 00 00 02 01 95 29 00 00 00 00 00 02 02 00 29 00 00 00 00 00 02 03 ac 29 00 00 00 00 00 02 04 00 29 00 00 00 00 00 02 05 ca 29 00 00 00 00 00 02 06 00 29 00 00 00 00 00 02 07 e1 29 00 00 00 00 00 02 08 00 29 00 00 00 00 00 02 09 f4 29 00 00 00 00 00 02 0a 01 29 00 00 00 00 00 02 0b 05 29 00 00 00 00 00 02 0c 01 29 00 00 00 00 00 02 0d 13 29 00 00 00 00 00 02 0e 01 29 00 00 00 00 00 02 0f 20 29 00 00 00 00 00 02 10 01 29 00 00 00 00 00 02 11 2c 29 00 00 00 00 00 02 12 01 29 00 00 00 00 00 02 13 55 29 00 00 00 00 00 02 14 01 29 00 00 00 00 00 02 15 76 29 00 00 00 00 00 02 16 01 29 00 00 00 00 00 02 17 ab 29 00 00 00 00 00 02 18 01 29 00 00 00 00 00 02 19 d5 29 00 00 00 00 00 02 1a 02 29 00 00 00 00 00 02 1b 18 29 00 00 00 00 00 02 1c 02 29 00 00 00 00 00 02 1d 4e 29 00 00 00 00 00 02 1e 02 29 00 00 00 00 00 02 1f 50 29 00 00 00 00 00 02 20 02 29 00 00 00 00 00 02 21 81 29 00 00 00 00 00 02 22 02 29 00 00 00 00 00 02 23 b8 29 00 00 00 00 00 02 24 02 29 00 00 00 00 00 02 25 db 29 00 00 00 00 00 02 26 03 29 00 00 00 00 00 02 27 09 29 00 00 00 00 00 02 28 03 29 00 00 00 00 00 02 29 2a 29 00 00 00 00 00 02 2a 03 29 00 00 00 00 00 02 2b 5c 29 00 00 00 00 00 02 2c 03 29 00 00 00 00 00 02 2d 6a 29 00 00 00 00 00 02 2e 03 29 00 00 00 00 00 02 2f 76 29 00 00 00 00 00 02 30 03 29 00 00 00 00 00 02 31 83 29 00 00 00 00 00 02 32 03 29 00 00 00 00 00 02 33 91 29 00 00 00 00 00 02 34 03 29 00 00 00 00 00 02 35 a4 29 00 00 00 00 00 02 36 03 29 00 00 00 00 00 02 37 bd 29 00 00 00 00 00 02 38 03 29 00 00 00 00 00 02 39 d8 29 00 00 00 00 00 02 3a 03 29 00 00 00 00 00 02 3b e6 29 00 00 00 00 00 02 3c 00 29 00 00 00 00 00 02 3d 95 29 00 00 00 00 00 02 3e 00 29 00 00 00 00 00 02 3f ac 29 00 00 00 00 00 02 40 00 29 00 00 00 00 00 02 41 ca 29 00 00 00 00 00 02 42 00 29 00 00 00 00 00 02 43 e1 29 00 00 00 00 00 02 44 00 29 00 00 00 00 00 02 45 f4 29 00 00 00 00 00 02 46 01 29 00 00 00 00 00 02 47 05 29 00 00 00 00 00 02 48 01 29 00 00 00 00 00 02 49 13 29 00 00 00 00 00 02 4a 01 29 00 00 00 00 00 02 4b 20 29 00 00 00 00 00 02 4c 01 29 00 00 00 00 00 02 4d 2c 29 00 00 00 00 00 02 4e 01 29 00 00 00 00 00 02 4f 55 29 00 00 00 00 00 02 50 01 29 00 00 00 00 00 02 51 76 29 00 00 00 00 00 02 52 01 29 00 00 00 00 00 02 53 ab 29 00 00 00 00 00 02 54 01 29 00 00 00 00 00 02 55 d5 29 00 00 00 00 00 02 56 02 29 00 00 00 00 00 02 57 18 29 00 00 00 00 00 02 58 02 29 00 00 00 00 00 02 59 4e 29 00 00 00 00 00 02 5a 02 29 00 00 00 00 00 02 5b 50 29 00 00 00 00 00 02 5c 02 29 00 00 00 00 00 02 5d 81 29 00 00 00 00 00 02 5e 02 29 00 00 00 00 00 02 5f b8 29 00 00 00 00 00 02 60 02 29 00 00 00 00 00 02 61 db 29 00 00 00 00 00 02 62 03 29 00 00 00 00 00 02 63 09 29 00 00 00 00 00 02 64 03 29 00 00 00 00 00 02 65 2a 29 00 00 00 00 00 02 66 03 29 00 00 00 00 00 02 67 5c 29 00 00 00 00 00 02 68 03 29 00 00 00 00 00 02 69 6a 29 00 00 00 00 00 02 6a 03 29 00 00 00 00 00 02 6b 76 29 00 00 00 00 00 02 6c 03 29 00 00 00 00 00 02 6d 83 29 00 00 00 00 00 02 6e 03 29 00 00 00 00 00 02 6f 91 29 00 00 00 00 00 02 70 03 29 00 00 00 00 00 02 71 a4 29 00 00 00 00 00 02 72 03 29 00 00 00 00 00 02 73 bd 29 00 00 00 00 00 02 74 03 29 00 00 00 00 00 02 75 d8 29 00 00 00 00 00 02 76 03 29 00 00 00 00 00 02 77 e6 29 00 00 00 00 00 02 78 01 29 01 00 00 00 00 02 79 01 29 01 00 00 00 00 04 ff 78 07 05 29 01 00 00 00 00 02 00 17 29 01 00 00 00 00 02 01 17 29 01 00 00 00 00 02 02 17 29 01 00 00 00 00 02 03 60 29 01 00 00 00 00 02 04 20 29 01 00 00 00 00 04 ff 78 07 07 29 01 00 00 00 00 02 99 00 29 01 00 00 00 00 02 9a 00 29 01 00 00 00 00 02 a8 12 29 01 00 00 00 00 04 ff 78 07 00 29 01 00 00 00 00 02 35 00 29 01 00 00 00 00 03 51 0f ff 29 01 00 00 00 00 02 53 2c 29 01 00 00 00 00 02 55 01 05 01 00 00 78 00 02 11 00 29 01 00 00 00 00 04 ff 78 07 06 29 01 00 00 00 00 02 e3 00 29 01 00 00 00 00 04 ff 78 07 00 05 01 00 00 0a 00 02 29 00];
		qcom,mdss-dsi-off-command = [05 01 00 00 32 00 02 28 00 05 01 00 00 78 00 02 10 00];
		qcom,mdss-dsi-cabc-ui-command = [29 01 00 00 00 00 02 55 01];
		qcom,mdss-dsi-cabc-mv-command = [29 01 00 00 00 00 02 55 03];
		qcom,mdss-dsi-cabc-dis-command = [29 01 00 00 00 00 02 55 00];
		qcom,mdss-dsi-on-command-state = "dsi_lp_mode";
		qcom,mdss-dsi-off-command-state = "dsi_hs_mode";
		qcom,mdss-dsi-h-sync-pulse = <0x1>;
		qcom,mdss-dsi-traffic-mode = "burst_mode";
		qcom,mdss-dsi-bllp-eof-power-mode;
		qcom,mdss-dsi-bllp-power-mode;
		qcom,esd-check-enabled;
		qcom,mdss-dsi-panel-status-read-length = <0x1>;
		qcom,mdss-dsi-panel-max-error-count = <0x1e>;
		qcom,mdss-dsi-panel-status-command = <0x6010001 0x500010a>;
		qcom,mdss-dsi-panel-status-command-state = "dsi_lp_mode";
		qcom,mdss-dsi-panel-status-check-mode = "reg_read";
		qcom,mdss-dsi-panel-status-value = <0x9c>;
		qcom,mdss-dsi-lane-0-state;
		qcom,mdss-dsi-lane-1-state;
		qcom,mdss-dsi-lane-2-state;
		qcom,mdss-dsi-lane-3-state;
		qcom,mdss-dsi-hfp-power-mode;
		qcom,mdss-dsi-panel-timings = <0xf83c2800 0x6e722e40 0x30030400>;
		qcom,mdss-dsi-t-clk-post = <0x2>;
		qcom,mdss-dsi-t-clk-pre = <0x2d>;
		qcom,mdss-dsi-bl-min-level = <0x1>;
		qcom,mdss-dsi-bl-max-level = <0xfff>;
		qcom,mdss-dsi-dma-trigger = "trigger_sw";
		qcom,mdss-dsi-mdp-trigger = "none";
		qcom,mdss-dsi-lp11-init;
		qcom,mdss-dsi-bl-pmic-control-type = "bl_ctrl_wled";
		qcom,mdss-dsi-reset-sequence = <0x0 0xa 0x1 0xa>;
		qcom,mdss-pan-physical-width-dimension = <0x3e>;
		qcom,mdss-pan-physical-height-dimension = <0x6e>;
	        qcom,panel-supply-entries = <0x189>;
	};
};
