/* Copyright (c) 2016, Lenovo mobile Inc. All rights reserved.
 *
 * This program is free software; you can redistribute it and/or modify
 * it under the terms of the GNU General Public License version 2 and
 * only version 2 as published by the Free Software Foundation.
 *
 * This program is distributed in the hope that it will be useful,
 * but WITHOUT ANY WARRANTY; without even the implied warranty of
 * MERCHANTABILITY or FITNESS FOR A PARTICULAR PURPOSE.  See the
 * GNU General Public License for more details.
 */

#include "msm8937-pmi8950-karate.dtsi"
#include "msm8937-sar-sensor-karate-row.dtsi"

 / {
        model = "karate row";
	compatible ="qcom,msm8937-pmi8950-karate-row", "qcom,msm8937-pmi8950-qrd-sku1",
		   "qcom,msm8937-qrd", "qcom,msm8937", "qcom,qrd";
};
