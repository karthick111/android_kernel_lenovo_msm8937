/* Copyright (c) 2014, The Linux Foundation. All rights reserved.
 *
 * This program is free software; you can redistribute it and/or modify
 * it under the terms of the GNU General Public License version 2 and
 * only version 2 as published by the Free Software Foundation.
 *
 * This program is distributed in the hope that it will be useful,
 * but WITHOUT ANY WARRANTY; without even the implied warranty of
 * MERCHANTABILITY or FITNESS FOR A PARTICULAR PURPOSE.  See the
 * GNU General Public License for more details.
 */

/*---------------------------------------------------------------------------
 * This file is autogenerated file using gcdb parser. Please do not edit it.
 * Update input XML file to add a new entry or update variable in this file
 * VERSION = "1.0"
 *---------------------------------------------------------------------------*/
&mdss_mdp {
	dsi_hx8399c_tm_1080p_video: qcom,mdss_dsi_hx8399c_tm_1080p_video {
		qcom,mdss-dsi-panel-name = "hx8399c_1080p_video_tm";
		qcom,mdss-dsi-panel-type = "dsi_video_mode";
		qcom,mdss-dsi-panel-destination = "display_1";
		qcom,mdss-dsi-panel-framerate = <60>;
		qcom,mdss-dsi-virtual-channel-id = <0>;
		qcom,mdss-dsi-stream = <0>;
		qcom,mdss-dsi-panel-width = <1080>;
		qcom,mdss-dsi-panel-height = <1920>;
		//qcom,mdss-dsi-h-front-porch = <16>;
		//qcom,mdss-dsi-h-back-porch = <16>;
		//qcom,mdss-dsi-h-pulse-width = <16>;
		qcom,mdss-dsi-h-front-porch = <230>;
		qcom,mdss-dsi-h-back-porch = <30>;
		qcom,mdss-dsi-h-pulse-width = <30>;
		qcom,mdss-dsi-h-sync-skew = <0>;
		//qcom,mdss-dsi-v-back-porch = <3>;
		//qcom,mdss-dsi-v-front-porch = <9>;
		//qcom,mdss-dsi-v-pulse-width = <4>;
		qcom,mdss-dsi-v-back-porch = <6>;
		qcom,mdss-dsi-v-front-porch = <6>;
		qcom,mdss-dsi-v-pulse-width = <6>;
		qcom,mdss-dsi-h-left-border = <0>;
		qcom,mdss-dsi-h-right-border = <0>;
		qcom,mdss-dsi-v-top-border = <0>;
		qcom,mdss-dsi-v-bottom-border = <0>;
		qcom,mdss-dsi-bpp = <24>;
		qcom,mdss-dsi-color-order = "rgb_swap_rgb";
		qcom,mdss-dsi-underflow-color = <0xff>;
		qcom,mdss-dsi-border-color = <0>;
		qcom,mdss-dsi-on-command = [
                29 01 00 00 00 00 04 B9 FF 83 99
		29 01 00 00 00 00 03 51 0F FF
		29 01 00 00 00 00 02 53 2C
		29 01 00 00 00 00 02 55 01
		05 01 00 00 96 00 02 11 00
		29 01 00 00 00 00 02 BD 01
		29 01 00 00 00 00 02 B1 24
		29 01 00 00 00 00 02 BD 00
		29 01 00 00 00 00 02 D0 39
		05 01 00 00 32 00 02 29 00];
		qcom,mdss-dsi-off-command = [
                29 01 00 00 00 00 02 B1 00
                05 01 00 00 32 00 02 28 00
                05 01 00 00 78 00 02 10 00
                29 01 00 00 00 00 02 B1 01];
		qcom,mdss-dsi-cabc-ui-command = [29 01 00 00 00 00 02 D0 00
						29 01 00 00 00 00 02 55 01
						29 01 00 00 00 00 02 D0 39];
		qcom,mdss-dsi-cabc-mv-command = [29 01 00 00 00 00 02 D0 00
						29 01 00 00 00 00 02 55 03
						29 01 00 00 00 00 02 D0 39];
		qcom,mdss-dsi-cabc-dis-command = [29 01 00 00 00 00 02 D0 00
						29 01 00 00 00 00 02 55 00
						29 01 00 00 00 00 02 D0 39];
		qcom,mdss-dsi-on-command-state = "dsi_lp_mode";
		qcom,mdss-dsi-off-command-state = "dsi_hs_mode";
		qcom,mdss-dsi-h-sync-pulse = <1>;
		qcom,mdss-dsi-traffic-mode = "burst_mode";
		qcom,mdss-dsi-bllp-eof-power-mode;
		qcom,mdss-dsi-bllp-power-mode;
                qcom,esd-check-enabled;
		qcom,mdss-dsi-panel-status-read-length = <4>;
		qcom,mdss-dsi-panel-status-valid-params = <3>; 
		qcom,mdss-dsi-panel-max-error-count = <1>;
		qcom,mdss-dsi-panel-status-command = [06 01 00 01 05 00 01 09];
		qcom,mdss-dsi-panel-status-command-state = "dsi_hs_mode";
		qcom,mdss-dsi-panel-status-check-mode = "reg_read"; 
		qcom,mdss-dsi-panel-status-value = <0x80 0x73 0x04>;	
		qcom,mdss-dsi-lane-0-state;
		qcom,mdss-dsi-lane-1-state;
		qcom,mdss-dsi-lane-2-state;
		qcom,mdss-dsi-lane-3-state;
                qcom,mdss-dsi-hfp-power-mode; 
		//qcom,mdss-dsi-panel-timings = [D2 32 20 00 5E 62 26 34 26 03 04 00];
                qcom,mdss-dsi-panel-timings = [F7 3C 28 00 6E 70 2E 40 31 03 04 00];
		qcom,mdss-dsi-t-clk-post = <0x02>;
		//qcom,mdss-dsi-t-clk-pre = <0x27>;
		qcom,mdss-dsi-t-clk-pre = <0x2D>;
		qcom,mdss-dsi-bl-min-level = <1>;
		qcom,mdss-dsi-bl-max-level = <4095>;
		qcom,mdss-dsi-dma-trigger = "trigger_sw";
		qcom,mdss-dsi-mdp-trigger = "none";
                qcom,mdss-dsi-lp11-init;
		qcom,mdss-dsi-bl-pmic-control-type = "bl_ctrl_wled";
		qcom,mdss-dsi-reset-sequence = <1 20>, <0 2>, <1 20>;
		qcom,mdss-pan-physical-width-dimension = <68>;
		qcom,mdss-pan-physical-height-dimension = <120>;
	};
};
