/* Copyright (c) 2014, The Linux Foundation. All rights reserved.
 *
 * This program is free software; you can redistribute it and/or modify
 * it under the terms of the GNU General Public License version 2 and
 * only version 2 as published by the Free Software Foundation.
 *
 * This program is distributed in the hope that it will be useful,
 * but WITHOUT ANY WARRANTY; without even the implied warranty of
 * MERCHANTABILITY or FITNESS FOR A PARTICULAR PURPOSE.  See the
 * GNU General Public License for more details.
 */

/*---------------------------------------------------------------------------
 * This file is autogenerated file using gcdb parser. Please do not edit it.
 * Update input XML file to add a new entry or update variable in this file
 * VERSION = "1.0"
 *---------------------------------------------------------------------------*/
&mdss_mdp {
	dsi_hx8399c_yas_1080p_video: qcom,mdss_dsi_hx8399c_yas_1080p_video {
		qcom,mdss-dsi-panel-name = "hx8399c_1080p_video_yas";
		qcom,mdss-dsi-panel-type = "dsi_video_mode";
		qcom,mdss-dsi-panel-destination = "display_1";
		qcom,mdss-dsi-panel-framerate = <60>;
		qcom,mdss-dsi-virtual-channel-id = <0>;
		qcom,mdss-dsi-stream = <0>;
		qcom,mdss-dsi-panel-width = <1080>;
		qcom,mdss-dsi-panel-height = <1920>;
		qcom,mdss-dsi-h-front-porch = <43>;
		qcom,mdss-dsi-h-back-porch = <43>;
		qcom,mdss-dsi-h-pulse-width = <43>;
		qcom,mdss-dsi-h-sync-skew = <0>;
		qcom,mdss-dsi-v-back-porch = <6>;
		qcom,mdss-dsi-v-front-porch = <6>;
		qcom,mdss-dsi-v-pulse-width = <6>;
		qcom,mdss-dsi-h-left-border = <0>;
		qcom,mdss-dsi-h-right-border = <0>;
		qcom,mdss-dsi-v-top-border = <0>;
		qcom,mdss-dsi-v-bottom-border = <0>;
		qcom,mdss-dsi-bpp = <24>;
		qcom,mdss-dsi-color-order = "rgb_swap_rgb";
		qcom,mdss-dsi-underflow-color = <0xff>;
		qcom,mdss-dsi-border-color = <0>;
		qcom,mdss-dsi-on-command = [29 01 00 00 00 00 04 B9 FF 83 99
29 01 00 00 00 00 02 D2 33
29 01 00 00 00 00 10 B1 02 04 70 90 01 32 33 11 11 4D 57 56 73 02 02
29 01 00 00 00 00 0C B2 00 80 80 AE 05 07 5A 11 10 10 00
29 01 00 00 00 00 2E B4 00 FF 04 08 0C 00 00 00 10 00 00 02 00 24 02 04 09 21 03 00 00 0A 90 88 04 08 0C 00 00 00 04 00 00 02 00 24 02 04 08 00 00 02 88 00 08
29 01 00 00 00 00 22 D3 00 00 00 00 00 00 04 04 32 10 04 00 04 00 00 00 00 00 00 00 00 00 00 21 00 05 05 13 00 00 00 05 40
29 01 00 00 00 00 21 D5 00 00 21 20 19 19 18 18 00 00 01 00 18 18 03 02 19 19 00 00 00 00 00 00 00 00 31 31 30 30 2F 2F
29 01 00 00 00 00 21 D6 40 40 20 21 18 18 19 19 40 40 02 03 18 18 00 01 19 19 40 40 40 40 40 40 40 40 31 31 30 30 2F 2F
29 01 00 00 00 00 11 D8 00 00 00 00 00 00 00 00 00 00 00 00 00 00 00 00
29 01 00 00 00 00 02 BD 01
29 01 00 00 00 00 09 D8 AA AE EA AA AA AE EA AA
29 01 00 00 00 00 02 BD	00  
29 01 00 00 00 00 37 E0 01 11 1B 15 35 3F 4C 48 50 59 61 67 6B 72 7A 7D 82 8D 8E 98 8B 97 98 4B 44 47 7A 01 11 1B 15 35 3F 4C 48 50 59 60 67 6B 72 79 7D 83 8B 8E 97 8B 97 97 4B 44 47 7A    
29 01 00 00 00 00 03 C0 25 5a
29 01 00 00 00 00 03 B6 91 91
29 01 00 00 00 00 02 CC	00	 
29 01 00 00 00 00 02 36	01
29 01 00 00 00 00 04 C9 07 00 30
29 01 00 00 00 00 02 51 FF
29 01 00 00 00 00 02 53 2C	
29 01 00 00 00 00 02 55 01   
05 01 00 00 96 00 02 11 00
05 01 00 00 32 00 02 29 00];
		qcom,mdss-dsi-off-command = [05 01 00 00 32 00 02 28 00
					05 01 00 00 78 00 02 10 00];
		qcom,mdss-dsi-on-command-state = "dsi_lp_mode";
		qcom,mdss-dsi-off-command-state = "dsi_hs_mode";
		qcom,mdss-dsi-h-sync-pulse = <1>;
		qcom,mdss-dsi-traffic-mode = "burst_mode";
		qcom,mdss-dsi-bllp-eof-power-mode;
		qcom,mdss-dsi-bllp-power-mode;
                //qcom,esd-check-enabled;
		qcom,mdss-dsi-panel-status-read-length = <1>;
		qcom,mdss-dsi-panel-max-error-count = <30>;
		qcom,mdss-dsi-panel-status-command = [06 01 00 01 05 00 02 0A 08];
		qcom,mdss-dsi-panel-status-command-state = "dsi_hs_mode";
		qcom,mdss-dsi-panel-status-check-mode = "reg_read"; 
		qcom,mdss-dsi-panel-status-value = <0x9c>; 		
		qcom,mdss-dsi-lane-0-state;
		qcom,mdss-dsi-lane-1-state;
		qcom,mdss-dsi-lane-2-state;
		qcom,mdss-dsi-lane-3-state;
		qcom,mdss-dsi-panel-timings = [E1 34 24 00 64 68 28 38 2B 03 04 00];
		qcom,mdss-dsi-t-clk-post = <0x03>;
		qcom,mdss-dsi-t-clk-pre = <0x2A>;
		qcom,mdss-dsi-bl-min-level = <1>;
		qcom,mdss-dsi-bl-max-level = <4095>;
		qcom,mdss-dsi-dma-trigger = "trigger_sw";
		qcom,mdss-dsi-mdp-trigger = "none";
                qcom,mdss-dsi-lp11-init;
		qcom,mdss-dsi-bl-pmic-control-type = "bl_ctrl_wled";
		qcom,mdss-dsi-reset-sequence = <1 20>, <0 2>, <1 20>;
		//qcom,mdss-pan-physical-width-dimension = <64>;
		//qcom,mdss-pan-physical-height-dimension = <117>;
	};
};
